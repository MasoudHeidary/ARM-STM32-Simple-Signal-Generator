/*
 * APP.c
 *
 *  Created on: Jun 16, 2022
 *      Author: Masoud
 */

#include "APP.h"

#include "lcd.h"
#include <stdio.h>
#include <stdlib.h>


char MENU_LIST[MENU_LIST_LEN][16] = {
		"Sine Wave(1)",
		"Square Wave(2)",
		"Triangle (3)",
		"Sawtooth (4)"
};

void APP_init(void) {
	_rxFlag = false;
	_menuDisplayPointer = 0;
	_menuChoice = 0;

	APP_menuInit();

	APP_UARTInit();

	APP_waveInit();
}

// MENU -----------------------------------------------
void APP_menuInit(void) {
	lcd_init();
	lcd_clear();
	lcd_puts("Application...");
	HAL_Delay(3000);
	lcd_clear();
}

// show options on lcd
void APP_lcdMenuUpdate(void) {
	// print 2 choice per page
	int page = _menuDisplayPointer / MENU_OPTION_PER_PAGE;

	lcd_clear();
	for(int i=0; i<MENU_OPTION_PER_PAGE; i++) {
		lcd_gotoxy(1, i);
		lcd_puts(MENU_LIST[page * MENU_OPTION_PER_PAGE + i]);

		if((page * MENU_OPTION_PER_PAGE + i) == _menuDisplayPointer) {
			lcd_gotoxy(0, i);
			lcd_putchar('>');
		}
	}
}

// show message for selected option
void APP_lcdMenuSelect(void) {
	lcd_clear();
	lcd_gotoxy(0, 0);
	lcd_puts("Generating...");
	lcd_gotoxy(0, 1);
	lcd_puts(MENU_LIST[_menuChoice]);

	HAL_Delay(5000);
	APP_lcdMenuUpdate();
}


// go to next option in menu
void APP_menuNextOption(void) {
	_menuDisplayPointer = (_menuDisplayPointer + 1) % MENU_LIST_LEN;
	APP_lcdMenuUpdate();
}

// select current displayed option as selected option
void APP_menuSelectOption(void) {
	_menuChoice = _menuDisplayPointer;

	// reset output wave
	_DACPointer = 0;

	APP_lcdMenuSelect();
}


// UART -----------------------------
char _rx[1];
bool _rxFlag;

void APP_UARTInit(void) {
	HAL_UART_Receive_IT(APP_UART, (uint8_t *)_rx, 1);
}

void APP_UARTMenuSelect(void) {
	if(!_rxFlag)
		return;

	_rxFlag = false;
	APP_lcdMenuSelect();
}

void HAL_UART_RxCpltCallback(UART_HandleTypeDef *huart) {
	if(huart == APP_UART) {
		char selected_code = _rx[0];

		if(selected_code >= '1' && selected_code <= '4') {
			_menuChoice = selected_code - '1';
			_rxFlag = true;

			char str[20] = "";
			sprintf(str, "%d selected", _menuChoice);

			HAL_UART_Transmit_DMA(APP_UART, (uint8_t*)str, 20);
		}

		APP_UARTInit();
	}
}

// DAC & Timer ----------------------------
int _DACPointer = 0;

uint32_t DACValue_Sine[] = {
		0x800,0x880,0x900,0x97f,0x9fd,0xa78,0xaf1,0xb67,0xbda,0xc49,
		0xcb3,0xd19,0xd79,0xdd4,0xe29,0xe78,0xec0,0xf02,0xf3c,0xf6f,
		0xf9b,0xfbf,0xfdb,0xfef,0xffb,0xfff,0xffb,0xfef,0xfdb,0xfbf,
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		0x34c,0x3b6,0x425,0x498,0x50e,0x587,0x602,0x680,0x6ff,0x77f,
};

uint32_t DACValue_Square[] = {
		0xFFF, 0xFFF, 0xFFF, 0xFFF, 0xFFF, 0xFFF, 0xFFF, 0xFFF, 0xFFF, 0xFFF,
		0xFFF, 0xFFF, 0xFFF, 0xFFF, 0xFFF, 0xFFF, 0xFFF, 0xFFF, 0xFFF, 0xFFF,
		0xFFF, 0xFFF, 0xFFF, 0xFFF, 0xFFF, 0xFFF, 0xFFF, 0xFFF, 0xFFF, 0xFFF,
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		0x000, 0x000, 0x000, 0x000, 0x000, 0x000, 0x000, 0x000, 0x000, 0x000,
};

uint32_t DACValue_Triangle[] = {
		0x52,0xa4,0xf6,0x148,0x19a,0x1eb,0x23d,0x28f,0x2e1,0x333,
		0x385,0x3d7,0x429,0x47b,0x4cd,0x51e,0x570,0x5c2,0x614,0x666,
		0x6b8,0x70a,0x75c,0x7ae,0x800,0x851,0x8a3,0x8f5,0x947,0x999,
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		0x2e1,0x28f,0x23d,0x1eb,0x19a,0x148,0xf6,0xa4,0x52,0x0,
};

uint32_t DACValue_Sawtooth[] = {
		0x28,0x51,0x7a,0xa3,0xcc,0xf5,0x11e,0x147,0x170,0x199,
		0x1c2,0x1eb,0x214,0x23d,0x266,0x28f,0x2b8,0x2e1,0x30a,0x333,
		0x35b,0x384,0x3ad,0x3d6,0x3ff,0x428,0x451,0x47a,0x4a3,0x4cc,
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		0xe8e,0xeb7,0xee0,0xf09,0xf32,0xf5b,0xf84,0xfad,0xfd6,0xfff
};

uint32_t* DACWaves[4] = {
		DACValue_Sine,
		DACValue_Square,
		DACValue_Triangle,
		DACValue_Sawtooth,
};

void HAL_TIM_PeriodElapsedCallback(TIM_HandleTypeDef *htim) {
	if (htim == APP_Timer) {
		_DACPointer = (_DACPointer + 1) % 100;

		HAL_DAC_SetValue(APP_DAC, DAC_CHANNEL_1, DAC_ALIGN_12B_R, DACWaves[_menuChoice][_DACPointer]);
	}
}

void APP_waveInit(void) {
	HAL_TIM_Base_Start_IT(APP_Timer);
	HAL_DAC_Start(APP_DAC, DAC_CHANNEL_1);
}
